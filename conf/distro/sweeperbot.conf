## conf/distro/sweeperbot.conf
```bitbake
require conf/distro/poky.conf

include conf/machine/${MACHINE}-extra.conf

DISTRO = "sweeperbot"
DISTRO_NAME = "Sweeperbot"
DISTRO_VERSION = "1.0"

DISTRO_FEATURES:append = " wifi systemd usrmerge"
DISTRO_FEATURES:remove = "alsa bluetooth nfc nfs 3g"

DISTRO_FEATURES_BACKFILL_CONSIDERED += "sysvinit"
VIRTUAL-RUNTIME_init_manager = "systemd"
VIRTUAL-RUNTIME_initscripts = "systemd-compat-units"

LICENSE_FLAGS_ACCEPTED = "synaptics-killswitch"

hostname:pn-base-files = "sweeperbot"
```

## conf/layer.conf
```bitbake
# We have a conf and classes directory, add to BBPATH
BBPATH .= ":${LAYERDIR}"

# We have recipes-* directories, add to BBFILES
BBFILES += "${LAYERDIR}/recipes-*/*/*.bb \
            ${LAYERDIR}/recipes-*/*/*.bbappend"

BBFILE_COLLECTIONS += "meta-sweeperbot"
BBFILE_PATTERN_meta-sweeperbot = "^${LAYERDIR}/"
BBFILE_PRIORITY_meta-sweeperbot = "100"

LAYERDEPENDS_meta-sweeperbot = "core"
LAYERSERIES_COMPAT_meta-sweeperbot = "kirkstone mickledore scarthgap"
```

## conf/machine/raspberrypi3-64-extra.conf
```bitbake
MACHINE_FEATURES:remove = "touchscreen alsa bluetooth"

DISABLE_SPLASH = "1"
DISABLE_RPI_BOOT_LOGO = "1"
GPU_MEM = "16"
ENABLE_UART = "1"
CMDLINE_SERIAL = ""
# disable USB
ENABLE_DWC2_HOST = "0"
ENABLE_DWC2_OTG = "0"

RPI_EXTRA_CONFIG = '\n\
dtoverlay=pi3-miniuart-bt\n\
dtoverlay=pi3-disable-bt\n\
max_framebuffer=0\n\
max_usb_current=0\n\
dtparam=audio=off\n\
dtoverlay=act-led,trigger=none,activelow=off\n\
dtparam=pwr_led_activelow=off\n\
hdmi_blanking=2\n\
enable_tvout=0\n\
ignore_lcd=1\n\
'
```
